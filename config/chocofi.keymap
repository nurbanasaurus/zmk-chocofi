#include <behaviors.dtsi>
#include <dt-bindings/zmk/keys.h>
#include <dt-bindings/zmk/bt.h>

#define BASE 0
#define EXT  1
#define NAV  2
#define FUN  3
#define ADJ  4// macros definition
#define undo LC(Z)
#define redo LC(LS(Z))
#define prev_screen LC(LG(LEFT))
#define next_screen LC(LG(RIGHT))
#define meh LC(LS(LALT))
#define prev_win LA(TAB)
#define next_win LA(LS(TAB))
#define deg RA(LS(SEMI))// tune mod tap

&mt {
    flavor = "tap-preferred";
    tapping_term_ms = <200>;
};

// caps word settings

&caps_word {
    continue-list = <UNDERSCORE MINUS N1 N2 N3 N4 N5 N6 N7 N8 N9 N0>;
};

// main tree

label = "ZM_SELECT_WORD";
        compatible = "zmk,behavior-macro";
        #binding-cells = <0>;
        bindings =
            <&macro_press>,
            <&kp LCTRL>,
            <&macro_tap>,
            <&kp LEFT>,
            <&macro_press>,
            <&kp LSHFT>,
            <&macro_tap>,
            <&kp RIGHT>,
            <&macro_release>,
            <&kp LSHFT &kp LCTRL>;
    };

    label = "ZM_SELECT_WORD";
    compatible = "zmk,behavior-macro";
    #binding-cells = <0>;
    bindings =
        <&macro_press>,
        <&kp LCTRL>,
        <&macro_tap>,
        <&kp LEFT>,
        <&macro_press>,
        <&kp LSHFT>,
        <&macro_tap>,
        <&kp RIGHT>,
        <&macro_release>,
        <&kp LSHFT &kp LCTRL>;
};

label = "ZM_SELECT_WORD";
            compatible = "zmk,behavior-macro";
            #binding-cells = <0>;
            bindings = <&macro_press>,<&kp LCTRL>,<&macro_tap>,<&kp LEFT>,<&macro_press>,<&kp LSHFT>,<&macro_tap>,<&kp RIGHT>,<&macro_release>,<&kp LSHFT &kp LCTRL>;
        };

        label = "ZM_SELECT_WORD";
        compatible = "zmk,behavior-macro";
        #binding-cells = <0>;
        bindings = <&macro_press>,<&kp LCTRL>,<&macro_tap>,<&kp LEFT>,<&macro_press>,<&kp LSHFT>,<&macro_tap>,<&kp RIGHT>,<&macro_release>,<&kp LSHFT &kp LCTRL>;
    };

    label = "ZM_SELECT_WORD";
    compatible = "zmk,behavior-macro";
    #binding-cells = <0>;
    bindings = <&macro_press>,<&kp LCTRL>,<&macro_tap>,<&kp LEFT>,<&macro_press>,<&kp LSHFT>,<&macro_tap>,<&kp RIGHT>,<&macro_release>,<&kp LSHFT &kp LCTRL>;
};

label = "ZM_SELECT_WORD";
        compatible = "zmk,behavior-macro";
        #binding-cells = <0>;
        bindings = <&macro_press>,<&kp LCTRL>,<&macro_tap>,<&kp LEFT>,<&macro_press>,<&kp LSHFT>,<&macro_tap>,<&kp RIGHT>,<&macro_release>,<&kp LSHFT &kp LCTRL>;
    };
};

// combos for accents dead keys (for US_intl_altgr_deadkeys OS layout)

combos {
    compatible = "zmk,combos";

    combo_acc {
        timeout-ms = <50>;
        key-positions = <1 2>;
        layers = <0>;
        bindings = <&kp RA(SINGLE_QUOTE)>;
    };

    combo_grv {
        timeout-ms = <50>;
        key-positions = <2 3>;
        layers = <0>;
        bindings = <&kp RA(GRAVE)>;
    };

    combo_delwrd {
        bindings = <&kp LC(BACKSPACE)>;
        key-positions = <8 9>;
    };

    new_combo {
        bindings = <&kp ENTER>;
        key-positions = <19 34>;
    };
};

macros {
};

keymap {
    compatible = "zmk,keymap";

    default_layer {
        // ----------------------------------------------------------------------------------------------------------------------------
        // |    Q    |    W    |    F    |    P    |    B    |                      |    J    |    L    |    I    |    Y    |    ;    |
        // |    A    |    R    |    S    |    T    |    G    |                      |    M    |    N    |    E    |    I    |    O    |
        // |    Z    |    X    |    C    |    D    |    V    |                      |    K    |    H    |    ,    |    .    |    /    |
        //                               |   ESC   |  SPACE  |   TAB   |  |  RETURN |BACKSPACE|   DEL   |

        bindings = <
&kp Q  &kp W           &kp F      &kp P  &kp B  &kp J          &kp L            &kp U    &kp Y  &kp SEMICOLON
&kp A  &none           &none      &none  &kp G  &kp M          &none            &none    &none          &kp O
&kp Z  &kp X           &kp C      &kp D  &kp V  &kp K          &kp H        &kp COMMA  &kp DOT      &kp SLASH
              &kp LEFT_SHIFT  &kp SPACE  &mo 2  &sl 1  &kp BACKSPACE  &kp RIGHT_SHIFT
        >;
    };

    num_layer {
        bindings = <
&none  &none   &none   &none  &kp UNDER  &kp MINUS      &kp N7  &kp N8  &kp N9      &kp DELETE
&none  &none   &none   &none  &kp EQUAL   &kp PLUS      &kp N4  &kp N5  &kp N6       &kp ENTER
&none  &none   &none   &none      &none     &kp N0      &kp N1  &kp N2  &kp N3  &kp KP_NUMLOCK
              &trans  &trans      &mo 3     &trans  &kp PERIOD   &none
        >;
    };

    sym_layer {
        bindings = <
&kp EXCL                &kp AT               &kp HASH        &kp DOLLAR        &kp PERCENT       &kp CARET        &kp AMPS      &kp STAR            &none  &kp COLON
 &kp TAB  &kp LEFT_PARENTHESIS  &kp RIGHT_PARENTHESIS  &kp LEFT_BRACKET  &kp RIGHT_BRACKET  &kp LEFT_ARROW  &kp DOWN_ARROW  &kp UP_ARROW  &kp RIGHT_ARROW      &none
   &none                 &none         &kp LEFT_BRACE   &kp RIGHT_BRACE              &none           &none        &kp HOME       &kp END            &none      &none
                                                &none            &trans             &trans           &mo 3          &trans         &none
        >;
    };

    fun_layer {
        bindings = <
    &kp LC(LA(DELETE))   &none   &none       &none    &none  &kp C_VOL_UP         &none         &none  &none             &kp C_BRI_UP
                &kp F2  &kp F4  &kp F8     &kp F11  &kp F12  &kp C_VOL_DN         &none         &none  &none             &kp C_BRI_DN
&kp LC(LG(LEFT_ARROW))   &none   &none       &none    &none  &bt BT_SEL 0  &bt BT_SEL 1  &bt BT_SEL 2  &none  &kp LC(LG(RIGHT_ARROW))
                                 &none  &bt BT_PRV   &trans        &trans    &bt BT_NXT    &bt BT_CLR
        >;
    };
};

};
